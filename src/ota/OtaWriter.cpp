#include "ota/OtaWriter.h"

#include <Update.h>
#include <mbedtls/pk.h>

#include <cstring>

#include "core/Log.h"
// Generated by scripts/signing_key.py: defines NETIGNITE_OTA_PUBLIC_KEY if a key is configured.
#include "netignite_signing_key.h"

bool OtaWriter::requiresSignature() {
#ifdef NETIGNITE_OTA_PUBLIC_KEY
	return true;
#else
	return false;
#endif
}

bool OtaWriter::begin(const netignite::protocol::OtaRequest& request, String& error) {
	abort();

	if (requiresSignature() && request.signature.empty()) {
		error = "This firmware only installs signed updates, and the update has no signature";
		return false;
	}
	if (!Update.begin(request.size, U_FLASH)) {
		error = String("Can't start the update: ") + Update.errorString();
		return false;
	}

	request_ = request;
	written_ = 0;
	mbedtls_sha256_init(&sha_);
	mbedtls_sha256_starts(&sha_, 0);
	active_ = true;
	return true;
}

bool OtaWriter::write(const uint8_t* data, size_t length, String& error) {
	if (!active_) {
		error = "No update in progress";
		return false;
	}
	if (written_ + length > request_.size) {
		error = "The download is larger than announced";
		abort();
		return false;
	}

	mbedtls_sha256_update(&sha_, data, length);
	if (Update.write(const_cast<uint8_t*>(data), length) != length) {
		error = String("Writing to flash failed: ") + Update.errorString();
		abort();
		return false;
	}
	written_ += length;
	return true;
}

bool OtaWriter::finish(String& error) {
	if (!active_) {
		error = "No update in progress";
		return false;
	}
	if (written_ != request_.size) {
		error = "The download is incomplete";
		abort();
		return false;
	}

	uint8_t hash[32];
	mbedtls_sha256_finish(&sha_, hash);
	mbedtls_sha256_free(&sha_);

	if (memcmp(hash, request_.sha256.data(), sizeof(hash)) != 0) {
		error = "The download doesn't match its SHA-256";
		abort();
		return false;
	}
	if (!verifySignature(hash, error)) {
		abort();
		return false;
	}
	if (!Update.end()) {
		error = String("Can't activate the update: ") + Update.errorString();
		abort();
		return false;
	}

	active_ = false;
	return true;
}

void OtaWriter::abort() {
	if (!active_) return;
	active_ = false;
	mbedtls_sha256_free(&sha_);
	Update.abort();
}

bool OtaWriter::verifySignature(const uint8_t hash[32], String& error) const {
#ifdef NETIGNITE_OTA_PUBLIC_KEY
	static const char KEY[] = NETIGNITE_OTA_PUBLIC_KEY;

	mbedtls_pk_context key;
	mbedtls_pk_init(&key);
	int result = mbedtls_pk_parse_public_key(&key, reinterpret_cast<const unsigned char*>(KEY), sizeof(KEY));
	if (result == 0) {
		result = mbedtls_pk_verify(&key, MBEDTLS_MD_SHA256, hash, 32, request_.signature.data(),
		                           request_.signature.size());
	}
	mbedtls_pk_free(&key);

	if (result != 0) {
		error = "The update's signature is invalid";
		return false;
	}
	Log::info("Update signature verified");
#else
	(void)hash;
	(void)error;
#endif
	return true;
}
